## package/batocera/boot/uboot-aoc-65t33z/Config.in
```kconfig
config BR2_PACKAGE_UBOOT_AOC_65T33Z
    bool "uboot files for AOC 65T33Z"
    help
        uboot files for AOC 65T33Z
```

## package/batocera/boot/uboot-corelab-tvpro/Config.in
```kconfig
config BR2_PACKAGE_UBOOT_CORELAB_TVPRO
    bool "uboot files for CoreLab TVPro"
    help
        uboot files for CoreLab TVPro
```
